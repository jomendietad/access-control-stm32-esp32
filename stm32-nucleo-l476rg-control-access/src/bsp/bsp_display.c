#include "bsp_display.h"
#include "stm32l4xx_hal.h"
#include <string.h>

I2C_HandleTypeDef hi2c1;
#define SSD1306_ADDR (0x3C << 1)

/* Buffer de memoria para la pantalla (128 columnas x 8 páginas) */
static uint8_t display_buffer[1024];

/* Fuente ASCII estándar 5x7 (Desde el espacio ' ' hasta '~') */
static const uint8_t font5x7[][5] = {
    {0x00,0x00,0x00,0x00,0x00}, {0x00,0x00,0x5F,0x00,0x00}, {0x00,0x07,0x00,0x07,0x00}, {0x14,0x7F,0x14,0x7F,0x14},
    {0x24,0x2A,0x7F,0x2A,0x12}, {0x23,0x13,0x08,0x64,0x62}, {0x36,0x49,0x55,0x22,0x50}, {0x00,0x05,0x03,0x00,0x00},
    {0x00,0x1C,0x22,0x41,0x00}, {0x00,0x41,0x22,0x1C,0x00}, {0x14,0x08,0x3E,0x08,0x14}, {0x08,0x08,0x3E,0x08,0x08},
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    {0x00,0x00,0x7F,0x00,0x00}, {0x00,0x41,0x36,0x08,0x00}, {0x10,0x08,0x08,0x10,0x08}, {0x00,0x00,0x00,0x00,0x00}
};

static void SSD1306_SendCommand(uint8_t command) {
    uint8_t data[2] = {0x00, command};
    HAL_I2C_Master_Transmit(&hi2c1, SSD1306_ADDR, data, 2, 100);
}

void BSP_Display_Init(void) {
    /* 1. Habilitar los relojes del I2C1 y del puerto B */
    __HAL_RCC_I2C1_CLK_ENABLE();
    __HAL_RCC_GPIOB_CLK_ENABLE();

    /* 2. Configurar los pines PB8 (SCL) y PB9 (SDA) */
    GPIO_InitTypeDef GPIO_InitStruct = {0};
    GPIO_InitStruct.Pin = GPIO_PIN_8 | GPIO_PIN_9;
    GPIO_InitStruct.Mode = GPIO_MODE_AF_OD;
    GPIO_InitStruct.Pull = GPIO_PULLUP;
    GPIO_InitStruct.Speed = GPIO_SPEED_FREQ_VERY_HIGH;
    GPIO_InitStruct.Alternate = GPIO_AF4_I2C1;
    HAL_GPIO_Init(GPIOB, &GPIO_InitStruct);

    /* 3. Configuración de la estructura del I2C */
    hi2c1.Instance = I2C1;
    hi2c1.Init.Timing = 0x00702991;
    hi2c1.Init.OwnAddress1 = 0;
    hi2c1.Init.AddressingMode = I2C_ADDRESSINGMODE_7BIT;
    hi2c1.Init.DualAddressMode = I2C_DUALADDRESS_DISABLE;
    hi2c1.Init.OwnAddress2 = 0;
    hi2c1.Init.OwnAddress2Masks = I2C_OA2_NOMASK;
    hi2c1.Init.GeneralCallMode = I2C_GENERALCALL_DISABLE;
    hi2c1.Init.NoStretchMode = I2C_NOSTRETCH_DISABLE;
    
    if (HAL_I2C_Init(&hi2c1) != HAL_OK) {
        return; 
    }

    /* 4. Enviar comandos de inicialización al SSD1306 */
    uint8_t init_cmds[] = {0xAE, 0x20, 0x00, 0x81, 0x7F, 0xA1, 0xC8, 0xA6, 0xA8, 0x3F, 0xD3, 0x00, 0xD5, 0x80, 0xD9, 0xF1, 0xDA, 0x12, 0xDB, 0x40, 0x8D, 0x14, 0xAF};
    for(int i=0; i<sizeof(init_cmds); i++) {
        SSD1306_SendCommand(init_cmds[i]);
    }
}

void BSP_Display_Update(void) {
    /* Envía todo el buffer de 1024 bytes a la pantalla */
    HAL_I2C_Mem_Write(&hi2c1, SSD1306_ADDR, 0x40, 1, display_buffer, 1024, 1000);
}

void BSP_Display_Clear(void) {
    /* Llena el buffer de ceros (apaga todos los píxeles) */
    memset(display_buffer, 0, sizeof(display_buffer));
}

void BSP_Display_DrawChar(uint8_t x, uint8_t y_page, char c) {
    if (c < 32 || c > 126) c = '?'; // Si el caracter no existe, dibuja un '?'
    for (uint8_t i = 0; i < 5; i++) {
        display_buffer[x + i + (y_page * 128)] = font5x7[c - 32][i];
    }
}

void BSP_Display_DrawString(uint8_t x, uint8_t y_page, const char* str) {
    while (*str) {
        if (x > 122) break; // Evita escribir fuera de la pantalla
        BSP_Display_DrawChar(x, y_page, *str);
        x += 6; // 5 píxeles de la letra + 1 píxel de espacio
        str++;
    }
}

void BSP_Display_ShowStatus(const char* line1, const char* line2) {
    BSP_Display_Clear();
    
    /* Dibuja la línea 1 en la página 2 (renglón de arriba) */
    BSP_Display_DrawString(0, 2, line1);
    
    /* Dibuja la línea 2 en la página 5 (renglón de abajo) */
    BSP_Display_DrawString(0, 5, line2);
    
    BSP_Display_Update();
}